/***********************************************************************************************
*                      Copyright (C)
*文件名：iic24cxx.c
*文件描述：本文件包含IIC存储器芯片的大部分型号的驱动程序头文件，移植者只要修改几个关键定义的宏
*   就可以使用驱动。
*   IIC采用模拟I2C时序，如需要使用硬件IIC时序，则不适用本驱动程序，
*   本驱动程序包含两个文件，iic24cxx.h和iic24cxx.c
*本驱动如果有不当之处，请联系czhf201@163.com
*作者：蔡赵烽
*创建时间：2011年3月09日
*当前版本：V1.0
*修改记录
*----------------------------------------------------------------------------------------------
*修改时间：2011年12月30日
*修改人：蔡赵烽
*修改内容:修正了几个错误，简化了头文件每种型号的配置方式，由原来四项修改为3项。修改了器件地址字节
*的计算方式。
*修改后版本：v1.1
*----------------------------------------------------------------------------------------------
*修改时间：2012年1月14日
*修改人：蔡赵烽
*修改内容:优化了IIC波形
*修改后版本：v1.2
***********************************************************************************************
*修改时间：2013年8月1日
*修改人：胡江
*修改内容:修改了等待ack延时时间
*修改后版本：v1.2.1
***********************************************************************************************/
/*包含头文件，根据不同项目可以更改包含文件内容，但必须包含类型定义和Iic24cxx.h*/
#include "stm32f2xx.h"
#include "drv_system.h"
#include "user_typedefine.h"
#include "drv_i2c.h"
#include "drv_i2c24cxx.h"

uint8 const Iic24BitMap[4] = {0x00,0x01,0x03,0x07};
uint8 const Iic24BitLmap[4] = {0x07,0x6,0x4,0x00};

/***********************************************************************************************
*函数名：Iic24Init
*功能描述：管脚电路配置初始化，本函数完成的主要工作是将SCL,SDA,WP等管脚作为输出配置
*入口：无
*出口：无
***********************************************************************************************/
void Iic24Init(void)
{
//    IIC_EXTRA_INIT;
//    IicSCLOutput();
//    IicSDAOutput();
//#ifdef IIC24_WP
//    IicWPOutput();
//#endif
//    IicSetSCLPin();
//    IicSetSDAPin();
  
    IIC_Init();
}

/***********************************************************************************************
*函数名：Iic24Start
*功能描述：IIC起始状态
*入口：无
*出口：无
***********************************************************************************************/
void Iic24Start(void)
{
//    IicSetSDAPin();
//    IicNop();
//    IicSetSCLPin();
//    IicNop();IicNop();
//    IicResetSDAPin();
//    IicNop();IicNop();
//    IicResetSCLPin();
    IIC_Start();  
}

/***********************************************************************************************
*函数名：Iic24Stop
*功能描述：IIC停止状态
*入口：无
*出口：无
***********************************************************************************************/
void Iic24Stop(void)
{
//    IicResetSCLPin();
//    IicNop();
//    IicResetSDAPin();
//    IicNop();
//    IicSetSCLPin();
//    IicNop();
//    IicNop();
//    IicSetSDAPin();
    IIC_Stop();
}

/***********************************************************************************************
*函数名：Iic24Send8Bit
*功能描述：IIC发送8位数据
*入口：byte，待发送的字节
*出口：ack
***********************************************************************************************/
uint8 Iic24Send8Bit(uint8 byte)
{
//    uint8 i;
//    uint8 ack = 0;
//    for (i = 0;i < 8;i++)
//    {
//        if (!(byte & 0x80))
//            IicResetSDAPin();
//        else
//            IicSetSDAPin();
//        IicNop();IicNop();
//        IicSetSCLPin();
//        IicNop();IicNop();
//        IicNop();IicNop();
//        byte = byte << 1;
//        IicResetSCLPin();
//    }
//    IicSDAInput();
//    IicNop();//hujiang
//    IicNop();//hujiang
//    IicSetSCLPin();
//    IicNop();
//    IicNop();
//    IicNop();
//    ack = IicReadSDA();
//    IicResetSCLPin();
//    IicSDAOutput();
//    return ack;
    IIC_Send_Byte(byte); 
    return IIC_Wait_Ack();
}

/***********************************************************************************************
*函数名：Iic24Receive8Bit
*功能描述：IIC接收8位数据
*入口：无
*出口：接收到的字节
***********************************************************************************************/
uint8 Iic24Receive8Bit(unsigned char ack)
{
//    uint8 i;
//    uint8 byte = 0;
//    for (i = 0;i < 8;i++)
//    {
//        byte = byte << 1;
//        IicSetSCLPin();
//        IicNop();IicNop();
//        IicNop();IicNop();
//        if (IicReadSDA())
//            byte = byte | 0x01;
//        else
//            byte = byte & 0xfe;
//        IicResetSCLPin();
//        IicNop();IicNop();
//    }
//    return byte; 
    return IIC_Read_Byte(ack);
}

/***********************************************************************************************
*函数名：Iic24SendNACK
*功能描述：发送非应答位
*入口：无
*出口：无
***********************************************************************************************/
void Iic24SendNACK(void)
{
//    IicSDAOutput();
//    IicSetSDAPin();
//    IicNop();
//    IicSetSCLPin();
//    IicNop();
//    IicNop();
//    IicNop();
//    IicNop();
//    IicResetSCLPin();//注意,发送非应答时函数退出是SDA的极性是输出
    IIC_NAck();
}

/***********************************************************************************************
*函数名：Iic24SendACK
*功能描述：发送应答位
*入口：无
*出口：无
***********************************************************************************************/
void Iic24SendACK(void)
{
//    IicSDAOutput();
//    IicResetSDAPin();
//    IicNop();
//    IicSetSCLPin();
//    IicNop();
//    IicNop();
//    IicNop();
//    IicNop();
//    IicResetSCLPin();
//    IicSDAInput();
    IIC_Ack();
}

/***********************************************************************************************
*函数名:Iic24WriteOnePage
*功能:往Iic24写入一页字节的数据
*入口:chip_addr,芯片地址低三位A2,A1,A0,dst,读出数据地址,num,数据个数
*出口:无
***********************************************************************************************/
void Iic24WriteOnePage(uint8 chip_addr,uint16 addr,uint8 *src,uint16 num)
{
    uint8 dev,i;
    uint16 k,m = 0;
#if BLOCK_ADDR_BIT_LENGTH > 0
    dev = ((addr >> 8) & Iic24BitMap[BLOCK_ADDR_BIT_LENGTH]) + (chip_addr & Iic24BitLmap[BLOCK_ADDR_BIT_LENGTH]);
#else
    dev = chip_addr & 0x07;
#endif  
    dev = (dev << 1) + 0xA0;        //计算控制字
    do
    {
        i = 0;
        Iic24Start();
        if (Iic24Send8Bit(dev) == 1)
        {
            i = 1;
            m++;
            Iic24Stop();
            continue;
        }
#if ADDR_BYTE_LENGTH == 2
        if (Iic24Send8Bit(addr >> 8) == 1)
        {
            i = 1;
            m++;
            Iic24Stop();
            continue;
        }
#endif
        if (Iic24Send8Bit((uint8)addr) == 1)
        {
            i = 1;
            m++;
            Iic24Stop();
            continue;
        }
        for (k = 0;k < num ;k++)
        {
            if (Iic24Send8Bit(src[k]))
            {
                i = 1;
                m++;
                break;
            }
        }
        Iic24Stop();
    }while(i && (m < 500)); 

}

/***********************************************************************************************
*函数名:Iic24WriteBytes
*功能:向Iic24芯片写入多个字节
*入口:chip_addr,芯片地址低三位A2,A1,A0,src 数据源,num,数据个数
*出口:无
***********************************************************************************************/
void Iic24WriteBytes(uint8 chip_addr,uint16 addr,uint8 *src,uint16 num)
{
    uint16 page_remain;

#if IIC_PAGE_SIZE == 0
    Iic24WriteOnePage(uint8 chip_addr,uint16 addr,uint8 *src,uint16 num);
#endif
    while (num)
    {
        page_remain =  (uint16)IIC_PAGE_SIZE - (uint16)(addr & (IIC_PAGE_SIZE - 1));//计算本页剩余字节个数
        if (page_remain >= num) //如果本页允许容纳要写的所有字节
        {
            Iic24WriteOnePage(chip_addr,addr,src,num);
            num = 0;//退出循环
        }
        else
        {
            Iic24WriteOnePage(chip_addr,addr,src,page_remain);
            addr += page_remain;
            src += page_remain;
            num -= page_remain;
        }
    }
}

/***********************************************************************************************
*函数名:Iic24ReadBytes
*功能:读取Iic24存储芯片制定地址的若干个字节
*入口:chip_addr,芯片地址低三位A2,A1,A0,dst,读出数据地址,num,数据个数
*出口:无
***********************************************************************************************/
void Iic24ReadBytes(uint8 chip_addr,uint16 addr,uint8 *dst,uint16 num)
{
    uint8 i,dev;
    uint16 m = 0;
    uint16 k; 
#if BLOCK_ADDR_BIT_LENGTH > 0
    dev = ((addr >> 8) & Iic24BitMap[BLOCK_ADDR_BIT_LENGTH]) + (chip_addr & Iic24BitLmap[BLOCK_ADDR_BIT_LENGTH]);
#else
    dev = chip_addr & 0x07;
#endif  
    dev = (dev << 1) + 0xA0;        //计算控制字
    do
    {
        i = 0;
        Iic24Start();
        if (Iic24Send8Bit(dev) == 1)
        {
            i = 1;
            m++;
            Iic24Stop();
            continue;
        }
#if ADDR_BYTE_LENGTH == 2
        if (Iic24Send8Bit(addr >> 8) == 1)
        {
            i = 1;
            m++;
            Iic24Stop();
            continue;
        }
#endif
        if (Iic24Send8Bit(addr) == 1)
        {
            i = 1;
            m++;
            Iic24Stop();
            continue;
        }
        Iic24Start();
        if (Iic24Send8Bit(dev + 1) == 1)
        {
            i = 1;
            m++;
            Iic24Stop();
            continue;
        }
        IicSDAInput();
        for (k = 0;k < num - 1;k++)
        {
            dst[k] = Iic24Receive8Bit(1);
            //Iic24SendACK();
        }
        dst[k] = Iic24Receive8Bit(0);
        //Iic24SendNACK();
        Iic24Stop();
    }while(i && (m < 500));
}

//==================================================================================================
//| 函数名称 | WriteCharToEEPROM
//|----------|--------------------------------------------------------------------------------------
//| 函数功能 | 写入单个字节到EEPROM
//|----------|--------------------------------------------------------------------------------------
//|----------|--------------------------------------------------------------------------------------
//| 输入参数 | uin_Addr：要写入的EEPROM的地址 
//|          | uch_Data：要写入数据
//|----------|--------------------------------------------------------------------------------------       
//| 返回参数 | 无
//|----------|-------------------------------------------------------------------------------------- 
//| 函数设计 | clt  12.02.07
//================================================================================================== 
void WriteCharToEEPROM(uint16 uin_Addr, uint8 uch_Data)
{
    WriteEEPROM(uin_Addr, &uch_Data, 1);
}  

//==================================================================================================
//| 函数名称 | WriteIntToEEPROM
//|----------|--------------------------------------------------------------------------------------
//| 函数功能 | 写入16位整形到外部EEPROM
//|----------|--------------------------------------------------------------------------------------
//|----------|--------------------------------------------------------------------------------------
//| 输入参数 | uin_Addr：要写入的EEPROM的地址 
//|          | uin_Data：要写入数据
//|----------|--------------------------------------------------------------------------------------       
//| 返回参数 | 无
//|----------|-------------------------------------------------------------------------------------- 
//| 函数设计 | clt  12.02.07
//================================================================================================== 
void WriteIntToEEPROM(uint16 uin_Addr, uint16 uin_Data)
{
    WriteEEPROM(uin_Addr, (uint8 *)(&uin_Data), 2);
}  

//==================================================================================================
//| 函数名称 | WriteLongToEEPROM
//|----------|--------------------------------------------------------------------------------------
//| 函数功能 | 写入32位整形到外部EEPROM
//|----------|--------------------------------------------------------------------------------------
//|----------|--------------------------------------------------------------------------------------
//| 输入参数 | uin_Addr：要写入的EEPROM的地址 
//|          | ul_Data：要写入数据
//|----------|--------------------------------------------------------------------------------------       
//| 返回参数 | 无
//|----------|-------------------------------------------------------------------------------------- 
//| 函数设计 | clt  12.02.07
//================================================================================================== 
void WriteLongToEEPROM(uint16 uin_Addr, uint32 ul_Data)
{
    WriteEEPROM(uin_Addr, (uint8 *)(&ul_Data), 4);
} 


//==================================================================================================
//| 函数名称 | WriteFloatToEEPROM
//|----------|--------------------------------------------------------------------------------------
//| 函数功能 | 写入浮点数据到外部EEPROM
//|----------|--------------------------------------------------------------------------------------
//|----------|--------------------------------------------------------------------------------------
//| 输入参数 | uin_Addr：要写入的EEPROM的地址 
//|          | f_Data：  要写入数据
//|----------|--------------------------------------------------------------------------------------       
//| 返回参数 | 无
//|----------|-------------------------------------------------------------------------------------- 
//| 函数设计 | clt  12.02.07
//================================================================================================== 
void WriteFloatToEEPROM(uint16 uin_Addr, fp32 f_Data)
{
    WriteEEPROM(uin_Addr, (uint8 *)(&f_Data), 4);
} 

//==================================================================================================
//| 函数名称 | ReadCharFromEEPROM
//|----------|--------------------------------------------------------------------------------------
//| 函数功能 | 从外部EEPROM读取一个8位的整形数据
//|----------|--------------------------------------------------------------------------------------
//|----------|--------------------------------------------------------------------------------------
//| 输入参数 | uin_Addr：要读取的EEPROM的地址 
//|----------|--------------------------------------------------------------------------------------       
//| 返回参数 | 要读取的数据
//|----------|-------------------------------------------------------------------------------------- 
//| 函数设计 | clt  12.02.07
//================================================================================================== 
uint8 ReadCharFromEEPROM(uint16 uin_Addr)
{
    uint8 auch_Data[1];
    
    ReadEEPROM(uin_Addr, auch_Data, 1);
    return auch_Data[0];
} 

//==================================================================================================
//| 函数名称 | ReadIntFromEEPROM
//|----------|--------------------------------------------------------------------------------------
//| 函数功能 | 从外部EEPROM读取一个16位的整形数据
//|----------|--------------------------------------------------------------------------------------
//|----------|--------------------------------------------------------------------------------------
//| 输入参数 | uin_Addr：要读取的EEPROM的地址 
//|----------|--------------------------------------------------------------------------------------       
//| 返回参数 | 要读取的数据
//|----------|-------------------------------------------------------------------------------------- 
//| 函数设计 | clt  09.04.25
//================================================================================================== 
uint16 ReadIntFromEEPROM(uint16 uin_Addr)
{
    uint8 auch_Data[2];
  
    ReadEEPROM(uin_Addr, auch_Data, 2);
    return (*((uint16*)auch_Data));
} 

//==================================================================================================
//| 函数名称 | ReadLongFromEEPROM
//|----------|--------------------------------------------------------------------------------------
//| 函数功能 | 从外部EEPROM读取一个32位的整形数据
//|----------|--------------------------------------------------------------------------------------
//|----------|--------------------------------------------------------------------------------------
//| 输入参数 | uin_Addr：要读取的EEPROM的地址 
//|----------|--------------------------------------------------------------------------------------       
//| 返回参数 | 要读取的数据
//|----------|-------------------------------------------------------------------------------------- 
//| 函数设计 | clt  09.04.25
//================================================================================================== 
uint32 ReadLongFromEEPROM(uint16 uin_Addr)
{
    uint8 auch_Data[4];
  
    ReadEEPROM(uin_Addr, auch_Data, 4);
    return (*((uint32*)auch_Data));
}   

//==================================================================================================
//| 函数名称 | ReadFloatFromEEPROM
//|----------|--------------------------------------------------------------------------------------
//| 函数功能 | 从外部EEPROM读取一个浮点数据
//|----------|--------------------------------------------------------------------------------------
//|----------|--------------------------------------------------------------------------------------
//| 输入参数 | uin_Addr：要读取的EEPROM的地址 
//|----------|--------------------------------------------------------------------------------------       
//| 返回参数 | 要读取的数据
//|----------|-------------------------------------------------------------------------------------- 
//| 函数设计 | clt  09.04.25
//================================================================================================== 
fp32 ReadFloatFromEEPROM(uint16 uin_Addr)
{
    uint8 auch_Data[4];
    
    ReadEEPROM(uin_Addr, auch_Data, 4);
    return (*((fp32*)auch_Data));
}  

